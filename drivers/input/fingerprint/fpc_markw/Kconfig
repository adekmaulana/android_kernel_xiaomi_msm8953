## drivers/input/fingerprint/fpc_markw/Kconfig
```kconfig
config FINGERPRINT_FPC1020_MARKW
	tristate "FingerPrint Cards fingerprint drvier support"
	depends on INPUT_FINGERPRINT
	help
	  Say Y here to enable goodix fingerprint driver support!
```

## drivers/platform/xiaomi/Kconfig
```kconfig
# Xiaomi configuration options

config MACH_XIAOMI_MSM8953
	bool "Xiaomi MSM8953"
	depends on ARCH_MSM8953
	help
	  Support for MSM8953 Xiaomi variants

menu "Xiaomi board selection"

config MACH_XIAOMI_MIDO
	bool "Mido board"
	select MACH_XIAOMI_MSM8953
	help
	  Support for Redmi Note 4/4X SD Mido

menu "Mido compatibility selection"

config MIDO_TREBLE
	bool "Mido-treble board"
	select MACH_XIAOMI_MIDO
	help
	  Support for Redmi Note 4/4X SD Mido for treble compatibility

endmenu

endmenu
```
