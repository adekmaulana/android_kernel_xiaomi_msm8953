/* Copyright (c) 2013-2014, The Linux Foundation. All rights reserved.
 * Copyright (C) 2017 XiaoMi, Inc.
 *
 * This program is free software; you can redistribute it and/or modify
 * it under the terms of the GNU General Public License version 2 and
 * only version 2 as published by the Free Software Foundation.
 *
 * This program is distributed in the hope that it will be useful,
 * but WITHOUT ANY WARRANTY; without even the implied warranty of
 * MERCHANTABILITY or FITNESS FOR A PARTICULAR PURPOSE.  See the
 * GNU General Public License for more details.
 */

&mdss_mdp {
	dsi_nt35596_1080_vid: qcom,mdss_dsi_nt35596_ebbg_1080p_video {
		qcom,mdss-dsi-panel-name = "nt35596_1080p_video_EBBG";
		qcom,mdss-dsi-panel-controller = <&mdss_dsi0>;
		qcom,mdss-dsi-panel-type = "dsi_video_mode";
		qcom,mdss-dsi-panel-destination = "display_1";
		qcom,mdss-dsi-panel-framerate = <60>;
		qcom,mdss-dsi-virtual-channel-id = <0>;
		qcom,mdss-dsi-stream = <0>;
		qcom,mdss-dsi-panel-width = <1080>;
		qcom,mdss-dsi-panel-height = <1920>;
		qcom,mdss-dsi-h-front-porch = <124>;
		qcom,mdss-dsi-h-back-porch = <120>;
		qcom,mdss-dsi-h-pulse-width = <4>;
		qcom,mdss-dsi-h-sync-skew = <0>;
		qcom,mdss-dsi-v-back-porch = <15>;
		qcom,mdss-dsi-v-front-porch = <8>;
		qcom,mdss-dsi-v-pulse-width = <5>;
		qcom,mdss-dsi-h-left-border = <0>;
		qcom,mdss-dsi-h-right-border = <0>;
		qcom,mdss-dsi-v-top-border = <0>;
		qcom,mdss-dsi-v-bottom-border = <0>;
		qcom,mdss-dsi-bpp = <24>;
		qcom,mdss-dsi-underflow-color = <0xff>;
		qcom,mdss-dsi-border-color = <0>;
		qcom,mdss-dsi-on-command = <0x29010000 0x2ff 0xee290100 0xa0002 0x18402901 0xa00 0x2180029 0x1000000 0x2ff00 0x29010000 0x235 0x290100 0x2 0xd3142901 0x0 0x2d40829 0x1000000 0x2ff03 0x29010000 0x200 0x28290100 0x2 0x1282901 0x0 0x2022829 0x1000000 0x20328 0x29010000 0x204 0x28290100 0x2 0x5282901 0x0 0x2062829 0x1000000 0x20728 0x29010000 0x208 0x28290100 0x2 0x9282901 0x0 0x20a2829 0x1000000 0x20b28 0x29010000 0x20c 0x28290100 0x2 0xd282901 0x0 0x20e2829 0x1000000 0x20f28 0x29010000 0x210 0x28290100 0x2 0x11282901 0x0 0x2122829 0x1000000 0x21328 0x29010000 0x21a 0x290100 0x2 0x1b002901 0x0 0x21c0029 0x1000000 0x21d00 0x29010000 0x21e 0x290100 0x2 0x1f002901 0x0 0x2200029 0x1000000 0x22100 0x29010000 0x222 0x290100 0x2 0x23002901 0x0 0x2240029 0x1000000 0x22500 0x29010000 0x226 0x290100 0x2 0x27002901 0x0 0x2280029 0x1000000 0x22900 0x29010000 0x22a 0x290100 0x2 0x2b002901 0x0 0x22f0029 0x1000000 0x23000 0x29010000 0x231 0x290100 0x2 0x32962901 0x0 0x2339529 0x1000000 0x23414 0x29010000 0x235 0x14290100 0x2 0x36142901 0x0 0x2371729 0x1000000 0x2381b 0x29010000 0x239 0x1d290100 0x2 0x3a1c2901 0x0 0x23b1b29 0x1000000 0x23f18 0x29010000 0x240 0x14290100 0x2 0x41132901 0x0 0x2421229 0x1000000 0x24313 0x29010000 0x244 0x13290100 0x2 0x45112901 0x0 0x2460d29 0x1000000 0x24709 0x29010000 0x248 0x7290100 0x2 0x49072901 0x0 0x24a0f29 0x1000000 0x24b0c 0x29010000 0x24c 0xe290100 0x2 0x4d002901 0x0 0x24e0029 0x1000000 0x24f00 0x29010000 0x250 0x290100 0x2 0x51002901 0x0 0x2520029 0x1000000 0x25305 0x29010000 0x254 0x4290100 0x2 0x55042901 0x0 0x25b0029 0x1000000 0x26300 0x29010000 0x2fb 0x1290100 0x2 0xff002901 0x0 0x2350029 0x1000000 0x2d314 0x29010000 0x2d4 0x8290100 0x2 0x55b02901 0x7800 0x2110029 0x100000a 0x22900>;
		qcom,mdss-dsi-off-command = [05 01 00 00 32 00 02 28 00
					05 01 00 00 78 00 02 10 00];
		qcom,mdss-dsi-on-command-state = "dsi_lp_mode";
		qcom,mdss-dsi-off-command-state = "dsi_hs_mode";
		qcom,mdss-dsi-h-sync-pulse = <1>;
		qcom,mdss-dsi-traffic-mode = "burst_mode";
		qcom,mdss-dsi-bllp-eof-power-mode;
		qcom,mdss-dsi-bllp-power-mode;
		qcom,mdss-dsi-lane-0-state;
		qcom,mdss-dsi-lane-1-state;
		qcom,mdss-dsi-lane-2-state;
		qcom,mdss-dsi-lane-3-state;
		qcom,mdss-dsi-panel-timings = [F2 3A 28 00 6C 6E 2C 3E 2E 03 04 00];
		qcom,mdss-dsi-panel-timings-phy-v2 = [24 1F 08 09 05 03 04 A0
				24 1F 08 09 05 03 04 A0
				24 1F 08 09 05 03 04 A0
				24 1F 08 09 05 03 04 A0
				24 1C 08 09 05 03 04 A0];
		qcom,mdss-dsi-t-clk-post = <0x2>;
		qcom,mdss-dsi-t-clk-pre = <0x2D>;
		qcom,mdss-dsi-bl-min-level = <1>;
		qcom,mdss-dsi-bl-max-level = <4095>;
		qcom,mdss-dsi-dma-trigger = "trigger_sw";
		qcom,mdss-dsi-mdp-trigger = "none";
		qcom,mdss-dsi-bl-pmic-control-type = "bl_ctrl_wled";
		qcom,mdss-dsi-reset-sequence = <1 20>, <0 10>, <1 20>, <0 10>, <1 20>;
		qcom,mdss-dsi-panel-warm-command = <0x29010000 0x2ff 0x1290100 0x2 0xfb012900 0x0 0x2750029 0x0 0x27633 0x29000000 0x277 0x290000 0x2 0x78402900 0x0 0x2790029 0x0 0x27a5b 0x29000000 0x27b 0x290000 0x2 0x7c772900 0x0 0x27d0029 0x0 0x27e93 0x29000000 0x27f 0x290000 0x2 0x80a42900 0x0 0x2810029 0x0 0x282b4 0x29000000 0x283 0x290000 0x2 0x84c12900 0x0 0x2850029 0x0 0x286cb 0x29000000 0x287 0x290000 0x2 0x88fd2900 0x0 0x2890129 0x0 0x28a20 0x29000000 0x28b 0x1290000 0x2 0x8c5d2900 0x0 0x28d0129 0x0 0x28e8a 0x29000000 0x28f 0x1290000 0x2 0x90d42900 0x0 0x2910229 0x0 0x29212 0x29000000 0x293 0x2290000 0x2 0x94142900 0x0 0x2950229 0x0 0x2964b 0x29000000 0x297 0x2290000 0x2 0x98882900 0x0 0x2990229 0x0 0x29aac 0x29000000 0x29b 0x2290000 0x2 0x9ce22900 0x0 0x29d0329 0x0 0x29e0a 0x29000000 0x29f 0x3290000 0x2 0xa0332900 0x0 0x2a20329 0x0 0x2a342 0x29000000 0x2a4 0x3290000 0x2 0xa5512900 0x0 0x2a60329 0x0 0x2a75f 0x29000000 0x2a9 0x3290000 0x2 0xaa722900 0x0 0x2ab0329 0x0 0x2ac88 0x29000000 0x2ad 0x3290000 0x2 0xaeab2900 0x0 0x2af0329 0x0 0x2b0c9 0x29000000 0x2b1 0x3290000 0x2 0xb2cb2900 0x0 0x2b30029 0x0 0x2b433 0x29000000 0x2b5 0x290000 0x2 0xb6402900 0x0 0x2b70029 0x0 0x2b85b 0x29000000 0x2b9 0x290000 0x2 0xba772900 0x0 0x2bb0029 0x0 0x2bc93 0x29000000 0x2bd 0x290000 0x2 0xbea42900 0x0 0x2bf0029 0x0 0x2c0b4 0x29000000 0x2c1 0x290000 0x2 0xc2c12900 0x0 0x2c30029 0x0 0x2c4cb 0x29000000 0x2c5 0x290000 0x2 0xc6fd2900 0x0 0x2c70129 0x0 0x2c820 0x29000000 0x2c9 0x1290000 0x2 0xca5d2900 0x0 0x2cb0129 0x0 0x2cc8a 0x29000000 0x2cd 0x1290000 0x2 0xced42900 0x0 0x2cf0229 0x0 0x2d012 0x29000000 0x2d1 0x2290000 0x2 0xd2142900 0x0 0x2d30229 0x0 0x2d44b 0x29000000 0x2d5 0x2290000 0x2 0xd6882900 0x0 0x2d70229 0x0 0x2d8ac 0x29000000 0x2d9 0x2290000 0x2 0xdae22900 0x0 0x2db0329 0x0 0x2dc0a 0x29000000 0x2dd 0x3290000 0x2 0xde332900 0x0 0x2df0329 0x0 0x2e042 0x29000000 0x2e1 0x3290000 0x2 0xe2512900 0x0 0x2e30329 0x0 0x2e45f 0x29000000 0x2e5 0x3290000 0x2 0xe6722900 0x0 0x2e70329 0x0 0x2e888 0x29000000 0x2e9 0x3290000 0x2 0xeaab2900 0x0 0x2eb0329 0x0 0x2ecc9 0x29000000 0x2ed 0x3290100 0x2 0xeecb2900 0x0 0x2ef0029 0x0 0x2f0cb 0x29000000 0x2f1 0x290000 0x2 0xf2d22900 0x0 0x2f30029 0x0 0x2f4dd 0x29000000 0x2f5 0x290000 0x2 0xf6e72900 0x0 0x2f70029 0x0 0x2f8f1 0x29000000 0x2f9 0x290100 0x2 0xfafa2901 0x0 0x2fb0129 0x1000000 0x2ff02 0x29000000 0x200 0x1290000 0x2 0x1042900 0x0 0x2020129 0x0 0x2030d 0x29000000 0x204 0x1290000 0x2 0x5162900 0x0 0x2060129 0x0 0x20736 0x29000000 0x208 0x1290000 0x2 0x9502900 0x0 0x20a0129 0x0 0x20b7e 0x29000000 0x20c 0x1290000 0x2 0xda52900 0x0 0x20e0129 0x0 0x20fe7 0x29000000 0x210 0x2290000 0x2 0x111e2900 0x0 0x2120229 0x0 0x21320 0x29000000 0x214 0x2290000 0x2 0x15542900 0x0 0x2160229 0x0 0x21791 0x29000000 0x218 0x2290000 0x2 0x19b82900 0x0 0x21a0229 0x0 0x21beb 0x29000000 0x21c 0x3290000 0x2 0x1d0d2900 0x0 0x21e0329 0x0 0x21f36 0x29000000 0x220 0x3290000 0x2 0x21442900 0x0 0x2220329 0x0 0x22352 0x29000000 0x224 0x3290000 0x2 0x25612900 0x0 0x2260329 0x0 0x22774 0x29000000 0x228 0x3290000 0x2 0x29892900 0x0 0x22a0329 0x0 0x22b9e 0x29000000 0x22d 0x3290000 0x2 0x2fc52900 0x0 0x2300329 0x1000000 0x231cb 0x29000000 0x232 0x290000 0x2 0x33cb2900 0x0 0x2340029 0x0 0x235d2 0x29000000 0x236 0x290000 0x2 0x37dd2900 0x0 0x2380029 0x0 0x239e7 0x29000000 0x23a 0x290000 0x2 0x3bf12900 0x0 0x23d0029 0x0 0x23ffa 0x29000000 0x240 0x1290000 0x2 0x41042900 0x0 0x2420129 0x0 0x2430d 0x29000000 0x244 0x1290000 0x2 0x45162900 0x0 0x2460129 0x0 0x24736 0x29000000 0x248 0x1290000 0x2 0x49502900 0x0 0x24a0129 0x0 0x24b7e 0x29000000 0x24c 0x1290000 0x2 0x4da52900 0x0 0x24e0129 0x0 0x24fe7 0x29000000 0x250 0x2290000 0x2 0x511e2900 0x0 0x2520229 0x0 0x25320 0x29000000 0x254 0x2290000 0x2 0x55542900 0x0 0x2560229 0x0 0x25891 0x29000000 0x259 0x2290000 0x2 0x5ab82900 0x0 0x25b0229 0x0 0x25ceb 0x29000000 0x25d 0x3290000 0x2 0x5e0d2900 0x0 0x25f0329 0x0 0x26036 0x29000000 0x261 0x3290000 0x2 0x62442900 0x0 0x2630329 0x0 0x26452 0x29000000 0x265 0x3290000 0x2 0x66612900 0x0 0x2670329 0x0 0x26874 0x29000000 0x269 0x3290000 0x2 0x6a892900 0x0 0x26b0329 0x0 0x26c9e 0x29000000 0x26d 0x3290000 0x2 0x6ec52900 0x0 0x26f0329 0x1000000 0x270cb 0x29000000 0x271 0x290000 0x2 0x72f22900 0x0 0x2730029 0x0 0x274f6 0x29000000 0x275 0x290000 0x2 0x76fe2900 0x0 0x2770129 0x0 0x27807 0x29000000 0x279 0x1290000 0x2 0x7a0f2900 0x0 0x27b0129 0x0 0x27c17 0x29000000 0x27d 0x1290000 0x2 0x7e1e2900 0x0 0x27f0129 0x0 0x28024 0x29000000 0x281 0x1290000 0x2 0x822b2900 0x0 0x2830129 0x0 0x28448 0x29000000 0x285 0x1290000 0x2 0x865f2900 0x0 0x2870129 0x0 0x28888 0x29000000 0x289 0x1290000 0x2 0x8aaf2900 0x0 0x28b0129 0x0 0x28cec 0x29000000 0x28d 0x2290000 0x2 0x8e222900 0x0 0x28f0229 0x0 0x29023 0x29000000 0x291 0x2290000 0x2 0x92572900 0x0 0x2930229 0x0 0x29493 0x29000000 0x295 0x2290000 0x2 0x96ba2900 0x0 0x2970229 0x0 0x298ef 0x29000000 0x299 0x3290000 0x2 0x9a082900 0x0 0x29b0329 0x0 0x29c29 0x29000000 0x29d 0x3290000 0x2 0x9e332900 0x0 0x29f0329 0x0 0x2a042 0x29000000 0x2a2 0x3290000 0x2 0xa3522900 0x0 0x2a40329 0x0 0x2a563 0x29000000 0x2a6 0x3290000 0x2 0xa77b2900 0x0 0x2a90329 0x0 0x2aa9b 0x29000000 0x2ab 0x3290000 0x2 0xacc72900 0x0 0x2ad0329 0x0 0x2aecb 0x29000000 0x2af 0x290000 0x2 0xb0f22900 0x0 0x2b10029 0x0 0x2b2f6 0x29000000 0x2b3 0x290000 0x2 0xb4fe2900 0x0 0x2b50129 0x0 0x2b607 0x29000000 0x2b7 0x1290000 0x2 0xb80f2900 0x0 0x2b90129 0x0 0x2ba17 0x29000000 0x2bb 0x1290000 0x2 0xbc1e2900 0x0 0x2bd0129 0x0 0x2be24 0x29000000 0x2bf 0x1290000 0x2 0xc02b2900 0x0 0x2c10129 0x0 0x2c248 0x29000000 0x2c3 0x1290000 0x2 0xc45f2900 0x0 0x2c50129 0x0 0x2c688 0x29000000 0x2c7 0x1290000 0x2 0xc8af2900 0x0 0x2c90129 0x0 0x2caec 0x29000000 0x2cb 0x2290000 0x2 0xcc222900 0x0 0x2cd0229 0x0 0x2ce23 0x29000000 0x2cf 0x2290000 0x2 0xd0572900 0x0 0x2d10229 0x0 0x2d293 0x29000000 0x2d3 0x2290000 0x2 0xd4ba2900 0x0 0x2d50229 0x0 0x2d6ef 0x29000000 0x2d7 0x3290000 0x2 0xd8082900 0x0 0x2d90329 0x0 0x2da29 0x29000000 0x2db 0x3290000 0x2 0xdc332900 0x0 0x2dd0329 0x0 0x2de42 0x29000000 0x2df 0x3290000 0x2 0xe0522900 0x0 0x2e10329 0x0 0x2e263 0x29000000 0x2e3 0x3290000 0x2 0xe47b2900 0x0 0x2e50329 0x0 0x2e69b 0x29000000 0x2e7 0x3290000 0x2 0xe8c72900 0x0 0x2e90329 0x1000000 0x2eacb>;
		qcom,mdss-dsi-panel-cool-command = <0x29010000 0x2ff 0x1290100 0x2 0xfb012900 0x0 0x2750029 0x0 0x276b0 0x29000000 0x277 0x290000 0x2 0x78b92900 0x0 0x2790029 0x0 0x27ac5 0x29000000 0x27b 0x290000 0x2 0x7cd02900 0x0 0x27d0029 0x0 0x27ede 0x29000000 0x27f 0x290000 0x2 0x80ef2900 0x0 0x2810029 0x0 0x282fb 0x29000000 0x283 0x1290000 0x2 0x84052900 0x0 0x2850129 0x0 0x2860e 0x29000000 0x287 0x1290000 0x2 0x882f2900 0x0 0x2890129 0x0 0x28a53 0x29000000 0x28b 0x1290000 0x2 0x8c812900 0x0 0x28d0129 0x0 0x28eab 0x29000000 0x28f 0x1290000 0x2 0x90f12900 0x0 0x2910229 0x0 0x29229 0x29000000 0x293 0x2290000 0x2 0x942a2900 0x0 0x2950229 0x0 0x29660 0x29000000 0x297 0x2290000 0x2 0x989f2900 0x0 0x2990229 0x0 0x29ac7 0x29000000 0x29b 0x2290000 0x2 0x9cfd2900 0x0 0x29d0329 0x0 0x29e1f 0x29000000 0x29f 0x3290000 0x2 0xa04a2900 0x0 0x2a20329 0x0 0x2a358 0x29000000 0x2a4 0x3290000 0x2 0xa5632900 0x0 0x2a60329 0x0 0x2a775 0x29000000 0x2a9 0x3290000 0x2 0xaa862900 0x0 0x2ab0329 0x0 0x2ac9e 0x29000000 0x2ad 0x3290000 0x2 0xaec52900 0x0 0x2af0329 0x0 0x2b0ca 0x29000000 0x2b1 0x3290000 0x2 0xb2cb2900 0x0 0x2b30029 0x0 0x2b4b0 0x29000000 0x2b5 0x290000 0x2 0xb6b92900 0x0 0x2b70029 0x0 0x2b8c5 0x29000000 0x2b9 0x290000 0x2 0xbad02900 0x0 0x2bb0029 0x0 0x2bcde 0x29000000 0x2bd 0x290000 0x2 0xbeef2900 0x0 0x2bf0029 0x0 0x2c0fb 0x29000000 0x2c1 0x1290000 0x2 0xc2052900 0x0 0x2c30129 0x0 0x2c40e 0x29000000 0x2c5 0x1290000 0x2 0xc62f2900 0x0 0x2c70129 0x0 0x2c853 0x29000000 0x2c9 0x1290000 0x2 0xca812900 0x0 0x2cb0129 0x0 0x2ccab 0x29000000 0x2cd 0x1290000 0x2 0xcef12900 0x0 0x2cf0229 0x0 0x2d029 0x29000000 0x2d1 0x2290000 0x2 0xd22a2900 0x0 0x2d30229 0x0 0x2d460 0x29000000 0x2d5 0x2290000 0x2 0xd69f2900 0x0 0x2d70229 0x0 0x2d8c7 0x29000000 0x2d9 0x2290000 0x2 0xdafd2900 0x0 0x2db0329 0x0 0x2dc1f 0x29000000 0x2dd 0x3290000 0x2 0xde4a2900 0x0 0x2df0329 0x0 0x2e058 0x29000000 0x2e1 0x3290000 0x2 0xe2632900 0x0 0x2e30329 0x0 0x2e475 0x29000000 0x2e5 0x3290000 0x2 0xe6862900 0x0 0x2e70329 0x0 0x2e89e 0x29000000 0x2e9 0x3290000 0x2 0xeac52900 0x0 0x2eb0329 0x0 0x2ecca 0x29000000 0x2ed 0x3290100 0x2 0xeecb2900 0x0 0x2ef0029 0x0 0x2f09e 0x29000000 0x2f1 0x290000 0x2 0xf2a62900 0x0 0x2f30029 0x0 0x2f4b7 0x29000000 0x2f5 0x290000 0x2 0xf6c62900 0x0 0x2f70029 0x0 0x2f8d5 0x29000000 0x2f9 0x290100 0x2 0xfae12901 0x0 0x2fb0129 0x1000000 0x2ff02 0x29000000 0x200 0x290000 0x2 0x1ec2900 0x0 0x2020029 0x0 0x203f6 0x29000000 0x204 0x1290000 0x2 0x5002900 0x0 0x2060129 0x0 0x20725 0x29000000 0x208 0x1290000 0x2 0x9462900 0x0 0x20a0129 0x0 0x20b7a 0x29000000 0x20c 0x1290000 0x2 0xda62900 0x0 0x20e0129 0x0 0x20fec 0x29000000 0x210 0x2290000 0x2 0x11262900 0x0 0x2120229 0x0 0x21328 0x29000000 0x214 0x2290000 0x2 0x155f2900 0x0 0x2160229 0x0 0x2179f 0x29000000 0x218 0x2290000 0x2 0x19c72900 0x0 0x21a0229 0x0 0x21bfd 0x29000000 0x21c 0x3290000 0x2 0x1d1f2900 0x0 0x21e0329 0x0 0x21f4a 0x29000000 0x220 0x3290000 0x2 0x21582900 0x0 0x2220329 0x0 0x22364 0x29000000 0x224 0x3290000 0x2 0x25762900 0x0 0x2260329 0x0 0x22786 0x29000000 0x228 0x3290000 0x2 0x29992900 0x0 0x22a0329 0x0 0x22bae 0x29000000 0x22d 0x3290000 0x2 0x2fc92900 0x0 0x2300329 0x1000000 0x231cb 0x29000000 0x232 0x290000 0x2 0x339e2900 0x0 0x2340029 0x0 0x235a6 0x29000000 0x236 0x290000 0x2 0x37b72900 0x0 0x2380029 0x0 0x239c6 0x29000000 0x23a 0x290000 0x2 0x3bd52900 0x0 0x23d0029 0x0 0x23fe1 0x29000000 0x240 0x290000 0x2 0x41ec2900 0x0 0x2420029 0x0 0x243f6 0x29000000 0x244 0x1290000 0x2 0x45002900 0x0 0x2460129 0x0 0x24725 0x29000000 0x248 0x1290000 0x2 0x49462900 0x0 0x24a0129 0x0 0x24b7a 0x29000000 0x24c 0x1290000 0x2 0x4da62900 0x0 0x24e0129 0x0 0x24fec 0x29000000 0x250 0x2290000 0x2 0x51262900 0x0 0x2520229 0x0 0x25328 0x29000000 0x254 0x2290000 0x2 0x555f2900 0x0 0x2560229 0x0 0x2589f 0x29000000 0x259 0x2290000 0x2 0x5ac72900 0x0 0x25b0229 0x0 0x25cfd 0x29000000 0x25d 0x3290000 0x2 0x5e1f2900 0x0 0x25f0329 0x0 0x2604a 0x29000000 0x261 0x3290000 0x2 0x62582900 0x0 0x2630329 0x0 0x26464 0x29000000 0x265 0x3290000 0x2 0x66752900 0x0 0x2670329 0x0 0x26886 0x29000000 0x269 0x3290000 0x2 0x6a992900 0x0 0x26b0329 0x0 0x26cae 0x29000000 0x26d 0x3290000 0x2 0x6ec92900 0x0 0x26f0329 0x1000000 0x270cb 0x29000000 0x271 0x290000 0x2 0x72302900 0x0 0x2730029 0x0 0x2743f 0x29000000 0x275 0x290000 0x2 0x765c2900 0x0 0x2770029 0x0 0x27872 0x29000000 0x279 0x290000 0x2 0x7a852900 0x0 0x27b0029 0x0 0x27c97 0x29000000 0x27d 0x290000 0x2 0x7ea92900 0x0 0x27f0029 0x0 0x280ba 0x29000000 0x281 0x290000 0x2 0x82c72900 0x0 0x2830029 0x0 0x284f7 0x29000000 0x285 0x1290000 0x2 0x861e2900 0x0 0x2870129 0x0 0x2885c 0x29000000 0x289 0x1290000 0x2 0x8a8c2900 0x0 0x28b0129 0x0 0x28cdc 0x29000000 0x28d 0x2290000 0x2 0x8e1b2900 0x0 0x28f0229 0x0 0x2901d 0x29000000 0x291 0x2290000 0x2 0x92562900 0x0 0x2930229 0x0 0x29498 0x29000000 0x295 0x2290000 0x2 0x96c12900 0x0 0x2970229 0x0 0x298fb 0x29000000 0x299 0x3290000 0x2 0x9a1d2900 0x0 0x29b0329 0x0 0x29c47 0x29000000 0x29d 0x3290000 0x2 0x9e542900 0x0 0x29f0329 0x0 0x2a060 0x29000000 0x2a2 0x3290000 0x2 0xa3722900 0x0 0x2a40329 0x0 0x2a582 0x29000000 0x2a6 0x3290000 0x2 0xa79c2900 0x0 0x2a90329 0x0 0x2aac3 0x29000000 0x2ab 0x3290000 0x2 0xacc92900 0x0 0x2ad0329 0x0 0x2aecb 0x29000000 0x2af 0x290000 0x2 0xb0302900 0x0 0x2b10029 0x0 0x2b23f 0x29000000 0x2b3 0x290000 0x2 0xb45c2900 0x0 0x2b50029 0x0 0x2b672 0x29000000 0x2b7 0x290000 0x2 0xb8852900 0x0 0x2b90029 0x0 0x2ba97 0x29000000 0x2bb 0x290000 0x2 0xbca92900 0x0 0x2bd0029 0x0 0x2beba 0x29000000 0x2bf 0x290000 0x2 0xc0c72900 0x0 0x2c10029 0x0 0x2c2f7 0x29000000 0x2c3 0x1290000 0x2 0xc41e2900 0x0 0x2c50129 0x0 0x2c65c 0x29000000 0x2c7 0x1290000 0x2 0xc88c2900 0x0 0x2c90129 0x0 0x2cadc 0x29000000 0x2cb 0x2290000 0x2 0xcc1b2900 0x0 0x2cd0229 0x0 0x2ce1d 0x29000000 0x2cf 0x2290000 0x2 0xd0562900 0x0 0x2d10229 0x0 0x2d298 0x29000000 0x2d3 0x2290000 0x2 0xd4c12900 0x0 0x2d50229 0x0 0x2d6fb 0x29000000 0x2d7 0x3290000 0x2 0xd81d2900 0x0 0x2d90329 0x0 0x2da47 0x29000000 0x2db 0x3290000 0x2 0xdc542900 0x0 0x2dd0329 0x0 0x2de60 0x29000000 0x2df 0x3290000 0x2 0xe0722900 0x0 0x2e10329 0x0 0x2e282 0x29000000 0x2e3 0x3290000 0x2 0xe49c2900 0x0 0x2e50329 0x0 0x2e6c3 0x29000000 0x2e7 0x3290000 0x2 0xe8c92900 0x0 0x2e90329 0x1000000 0x2eacb>;
		qcom,mdss-dsi-panel-nature-command = [
				29 01 00 00 00 00 02 FB 00
				29 01 00 00 00 00 02 FF 00
				29 01 00 00 00 00 02 11 00];
		qcom,mdss-dsi-panel-ce-std-command = [29 01 00 00 00 00 02 FF 00
				29 01 00 00 00 00 02 55 00];
		qcom,mdss-dsi-panel-ce-bright-command = [29 01 00 00 00 00 02 FF 00
				29 01 00 00 00 00 02 55 80];
		qcom,mdss-dsi-panel-ce-vivid-command = [29 01 00 00 00 00 02 FF 00
				29 01 00 00 00 00 02 55 B0];
		qcom,mdss-dsi-panel-gamma-command-state = "dsi_hs_mode";
		qcom,mdss-dsi-panel-ce-command-state = "dsi_hs_mode";
		qcom,mdss-dsi-lp11-init;
		qcom,mdss-dsi-init-delay-us = <50000>;
		qcom,mdss-pan-physical-width-dimension = <62>;
		qcom,mdss-pan-physical-height-dimension = <110>;
		qcom,mdss-night-brightness = <0x9 0x1b 0x2d 0x3f>;

	};
};
